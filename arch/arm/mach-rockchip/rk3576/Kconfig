## arch/arm/mach-rockchip/rk3576/Kconfig
```kconfig
if ROCKCHIP_RK3576

config ROCKCHIP_BOOT_MODE_REG
	default 0x26024040

config ROCKCHIP_STIMER_BASE
	default 0x27400000

config SYS_SOC
	default "rk3576"

config CUSTOM_SYS_INIT_SP_ADDR
	default 0x43f00000

config SYS_MALLOC_F_LEN
	default 0x10000

config SPL_SYS_MALLOC_F_LEN
	default 0x8000

config TPL_SYS_MALLOC_F_LEN
	default 0x4000

config TEXT_BASE
	default 0x40200000

config SPL_TEXT_BASE
	default 0x40000000

config SPL_HAS_BSS_LINKER_SECTION
	default y if ARM64

config SPL_BSS_START_ADDR
	default 0x43f80000

config SPL_BSS_MAX_SIZE
	default 0x8000

config SPL_STACK_R
	default y

config SPL_STACK_R_ADDR
	default 0x43e00000

config SPL_STACK_R_MALLOC_SIMPLE_LEN
	default 0x200000

endif
```

## board/hardkernel/odroid_m1s/Kconfig
```kconfig
if TARGET_ODROID_M1S_RK3566

config SYS_BOARD
	default "odroid_m1s"

config SYS_VENDOR
	default "hardkernel"

config SYS_CONFIG_NAME
	default "odroid_m1s"

config BOARD_SPECIFIC_OPTIONS # dummy
	def_bool y

endif
```
