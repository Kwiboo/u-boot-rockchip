// SPDX-License-Identifier: GPL-2.0+
/*
 * Copyright (C) 2019 Jagan Teki <jagan@amarulasolutions.com>
 */

#include "rockchip-u-boot.dtsi"

&gpio0 {
	gpio-ranges = <&pinctrl 0 0 32>;
};

&gpio1 {
	gpio-ranges = <&pinctrl 0 32 32>;
};

&gpio2 {
	gpio-ranges = <&pinctrl 0 64 32>;
};
