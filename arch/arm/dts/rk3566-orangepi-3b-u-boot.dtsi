// SPDX-License-Identifier: GPL-2.0+

#include "rk356x-u-boot.dtsi"

&gpio4 {
	bootph-pre-ram;
};

&sfc {
	flash@0 {
		bootph-pre-ram;
		bootph-some-ram;
	};
};

&vdd_npu {
	regulator-always-on;
	regulator-boot-on;
	regulator-init-microvolt = <900000>;
};
