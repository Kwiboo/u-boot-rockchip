## arch/arm/mach-rockchip/rk3562/Kconfig
```kconfig
if ROCKCHIP_RK3562

choice
	prompt "RK3562 board select"

config TARGET_EVB_RK3562
	bool "EVB_RK3562"
	select BOARD_LATE_INIT
	help
	  RK3562 EVB is a evaluation board for Rockchp RK3562.

endchoice

config ROCKCHIP_BOOT_MODE_REG
	default 0xff010220

config ROCKCHIP_STIMER_BASE
	default 0xffa90020

config SYS_SOC
	default "rk3562"

source board/rockchip/evb_rk3562/Kconfig

endif
```

## arch/arm/mach-rockchip/rk3568/Kconfig
```kconfig
if ROCKCHIP_RK3568

config TARGET_EVB_RK3568
	bool "RK3568 evaluation board"
	select BOARD_LATE_INIT
	help
	  RK3568 EVB is a evaluation board for Rockchip RK3568.

config ROCKCHIP_BOOT_MODE_REG
	default 0xfdc20200

config ROCKCHIP_STIMER_BASE
	default 0xfdd1c020

config SYS_SOC
	default "rk3568"

config ROCKCHIP_COMMON_STACK_ADDR
	default y

config TEXT_BASE
	default 0x00a00000

config SYS_MALLOC_F_LEN
	default 0x400

source board/rockchip/evb_rk3568/Kconfig

endif
```

## configs/rk3562_defconfig
```kconfig
CONFIG_ARM=y
CONFIG_ARCH_ROCKCHIP=y
CONFIG_SYS_MALLOC_F_LEN=0x80000
CONFIG_SF_DEFAULT_MODE=0x3
CONFIG_DEFAULT_DEVICE_TREE="rk3562-evb"
CONFIG_ROCKCHIP_RK3562=y
CONFIG_ROCKCHIP_NEW_IDB=y
CONFIG_ROCKCHIP_FIT_IMAGE=y
CONFIG_SPL_DRIVERS_MISC=y
CONFIG_SPL_SYS_MALLOC_F_LEN=0x100000
CONFIG_SPL_BSS_START_ADDR=0x3fe0000
CONFIG_SPL_BSS_MAX_SIZE=0x8000
CONFIG_SYS_LOAD_ADDR=0xc00800
CONFIG_DEBUG_UART_BASE=0xff210000
CONFIG_DEBUG_UART_CLOCK=24000000
CONFIG_SPL_LIBDISK_SUPPORT=y
CONFIG_BUILD_TARGET=""
CONFIG_DEBUG_UART=y
# CONFIG_EFI_LOADER is not set
CONFIG_ANDROID_BOOT_IMAGE_HASH=y
CONFIG_SPL_FIT_IMAGE_POST_PROCESS=y
CONFIG_SPL_FIT_IMAGE_KB=2048
CONFIG_BOOTDELAY=0
# CONFIG_DISPLAY_CPUINFO is not set
# CONFIG_MISC_INIT_R is not set
CONFIG_AVB_VERIFY=y
CONFIG_AVB_BUF_ADDR=0x2000000
CONFIG_AVB_BUF_SIZE=0x2000000
CONFIG_BOARD_RNG_SEED=y
CONFIG_SPL_MAX_SIZE=0x80000
# CONFIG_SPL_SKIP_RELOCATE is not set
CONFIG_SPL_BOARD_INIT=y
# CONFIG_SPL_RAW_IMAGE_SUPPORT is not set
CONFIG_SYS_MMCSD_RAW_MODE_U_BOOT_USE_PARTITION=y
CONFIG_SPL_CRYPTO=y
CONFIG_SPL_MTD=y
CONFIG_SPL_DM_RESET=y
CONFIG_SPL_RESET_ROCKCHIP=y
CONFIG_SPL_SPI_FLASH_MTD=y
# CONFIG_CMD_BDI is not set
CONFIG_CMD_BOOTZ=y
# CONFIG_CMD_ELF is not set
# CONFIG_CMD_IMI is not set
# CONFIG_CMD_XIMG is not set
# CONFIG_CMD_LZMADEC is not set
# CONFIG_CMD_UNZIP is not set
CONFIG_CMD_GPT=y
# CONFIG_CMD_LOADB is not set
# CONFIG_CMD_LOADS is not set
CONFIG_CMD_MMC=y
CONFIG_CMD_MTD=y
CONFIG_CMD_MTD_BLK=y
CONFIG_CMD_SPI=y
CONFIG_CMD_USB=y
CONFIG_ROCKUSB_MAX_SPEED_HS=y
CONFIG_CMD_USB_MASS_STORAGE=y
# CONFIG_CMD_ITEST is not set
# CONFIG_CMD_SETEXPR is not set
# CONFIG_NET_TFTP_VARS is not set
# CONFIG_ISO_PARTITION is not set
CONFIG_EFI_PARTITION_ENTRIES_NUMBERS=64
CONFIG_OF_SPL_REMOVE_PROPS="clock-names interrupt-parent assigned-clocks assigned-clock-rates assigned-clock-parents"
# CONFIG_SARADC_ROCKCHIP is not set
CONFIG_SARADC_ROCKCHIP_V2=y
CONFIG_BUTTON=y
CONFIG_BUTTON_ADC=y
CONFIG_BUTTON_GPIO=y
CONFIG_DM_HASH=y
CONFIG_HASH_SOFTWARE=y
CONFIG_FASTBOOT_BUF_ADDR=0xc00800
CONFIG_FASTBOOT_BUF_SIZE=0x04000000
CONFIG_ROCKCHIP_GPIO=y
CONFIG_SYS_I2C_ROCKCHIP=y
CONFIG_SPL_ROCKCHIP_SECURE_OTP=y
CONFIG_SUPPORT_EMMC_RPMB=y
CONFIG_MMC_HS400_ES_SUPPORT=y
CONFIG_SPL_MMC_HS400_ES_SUPPORT=y
CONFIG_MMC_HS400_SUPPORT=y
CONFIG_SPL_MMC_HS400_SUPPORT=y
CONFIG_MMC_DW=y
CONFIG_MMC_DW_ROCKCHIP=y
CONFIG_MMC_SDHCI=y
CONFIG_MMC_SDHCI_SDMA=y
CONFIG_MMC_SDHCI_ROCKCHIP=y
CONFIG_MTD_BLK=y
CONFIG_SPI_FLASH_GIGADEVICE=y
CONFIG_SPI_FLASH_MACRONIX=y
CONFIG_SPI_FLASH_WINBOND=y
CONFIG_SPI_FLASH_XMC=y
CONFIG_SPI_FLASH_XTX=y
CONFIG_SPI_FLASH_MTD=y
CONFIG_DM_ETH_PHY=y
CONFIG_DWC_ETH_QOS=y
CONFIG_PHY_ROCKCHIP_INNO_USB2=y
CONFIG_PHY_ROCKCHIP_NANENG_COMBOPHY=y
CONFIG_DM_CHARGE_DISPLAY=y
CONFIG_CHARGE_ANIMATION=y
CONFIG_DM_FUEL_GAUGE=y
CONFIG_POWER_FG_RK817=y
CONFIG_DM_PMIC=y
CONFIG_PMIC_RK8XX=y
CONFIG_REGULATOR_PWM=y
CONFIG_DM_REGULATOR_GPIO=y
CONFIG_REGULATOR_RK8XX=y
CONFIG_PWM_ROCKCHIP=y
CONFIG_BAUDRATE=1500000
CONFIG_DEBUG_UART_SHIFT=2
CONFIG_ROCKCHIP_SFC=y
CONFIG_TEE=y
CONFIG_OPTEE=y
CONFIG_ROCKCHIP_OPTEE_V2=y
CONFIG_USB=y
CONFIG_USB_XHCI_HCD=y
CONFIG_USB_XHCI_DWC3=y
CONFIG_USB_EHCI_HCD=y
CONFIG_USB_EHCI_GENERIC=y
CONFIG_USB_OHCI_HCD=y
CONFIG_USB_OHCI_GENERIC=y
CONFIG_USB_DWC3=y
CONFIG_USB_DWC3_GENERIC=y
CONFIG_USB_GADGET=y
CONFIG_USB_GADGET_PRODUCT_NUM=0x350d
CONFIG_USB_GADGET_DOWNLOAD=y
CONFIG_USB_FUNCTION_ROCKUSB=y
CONFIG_SPL_TINY_MEMSET=y
CONFIG_RSA=y
CONFIG_SPL_RSA=y
CONFIG_RSA_N_SIZE=0x200
CONFIG_RSA_E_SIZE=0x10
CONFIG_RSA_C_SIZE=0x20
CONFIG_XBC=y
CONFIG_LIBAVB=y
CONFIG_LIBAVB_AB=y
CONFIG_SPL_GZIP=y
CONFIG_ERRNO_STR=y
CONFIG_OPTEE_ALWAYS_USE_SECURITY_PARTITION=y
```
