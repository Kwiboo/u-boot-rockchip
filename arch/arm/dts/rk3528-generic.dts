// SPDX-License-Identifier: (GPL-2.0+ OR MIT)
/*
 * Minimal generic DT for RK3528 with eMMC and SD-card enabled
 */

/dts-v1/;
#include "rk3528.dtsi"

/ {
	model = "Generic RK3528";
	compatible = "rockchip,rk3528";

	chosen {
		stdout-path = "serial0:1500000n8";
	};
};

&uart0 {
	status = "okay";
};
