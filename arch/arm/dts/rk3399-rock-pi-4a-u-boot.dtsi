// SPDX-License-Identifier: GPL-2.0+
/*
 * Copyright (C) 2019 Jagan Teki <jagan@amarulasolutions.com>
 */

#include "rk3399-rock-pi-4-u-boot.dtsi"

/ {
	chosen {
		u-boot,spl-boot-order = "same-as-spl", &spi_flash, &sdhci, &sdmmc;
	};
};

&spi1 {
	spi_flash: flash@0 {
		bootph-all;
	};
};
