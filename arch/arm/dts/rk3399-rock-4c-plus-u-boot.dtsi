// SPDX-License-Identifier: (GPL-2.0+ OR MIT)
/*
 * Copyright (c) 2023 Radxa Limited
 */
#include "rk3399-rock-pi-4-u-boot.dtsi"

&pcfg_pull_none_18ma {
	bootph-pre-ram;
};

&pcfg_pull_up_8ma {
	bootph-pre-ram;
};

&spi1 {
	status = "okay";

	flash@0 {
		bootph-pre-ram;
		bootph-some-ram;
		compatible = "jedec,spi-nor";
		reg = <0>;
		spi-max-frequency = <10000000>;
	};
};
