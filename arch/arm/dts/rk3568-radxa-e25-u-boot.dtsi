// SPDX-License-Identifier: GPL-2.0+

#include "rk356x-u-boot.dtsi"

&sdhci {
	cap-mmc-highspeed;
	mmc-hs200-1_8v;
	mmc-hs400-1_8v;
	mmc-hs400-enhanced-strobe;
};

&usb_host0_xhci {
	dr_mode = "host";
};
