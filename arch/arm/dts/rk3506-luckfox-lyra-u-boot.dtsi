// SPDX-License-Identifier: (GPL-2.0+ OR MIT)

#include "rk3506-u-boot.dtsi"

&fspi {
	flash@0 {
		bootph-pre-ram;
		bootph-some-ram;
	};
};

&saradc {
	bootph-pre-ram;
	vdd-microvolts = <1800000>;
};
